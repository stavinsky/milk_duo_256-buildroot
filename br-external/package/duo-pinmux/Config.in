## br-external/package/duo-pinmux/Config.in
```kconfig
config BR2_PACKAGE_DUO_PINMUX
    bool "duo-pinmux"
    help
      pin multilexor for milk-duo series
      
      https://github.com/milkv-duo/duo-pinmux
```
