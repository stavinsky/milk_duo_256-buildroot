## br-external/Config.in
```kconfig
source "$BR2_EXTERNAL_br_ext_PATH/package/duo-pinmux/Config.in"
source "$BR2_EXTERNAL_br_ext_PATH/package/ephy-i2s2/Config.in"
```

## br-external/package/ephy-i2s2/Config.in
```kconfig
config BR2_PACKAGE_EPHY_I2S2
    bool "ephy-i2s2"
    depends on BR2_LINUX_KERNEL
    help
      Disable ephy pin output. 
```
